#include "oled.h"
#include <string.h>

static uint8_t OLED_GRAM[128][8];
static uint8_t OLED_dirty = 0xFF;
/* 每页脏列范围: 只刷 [col_min, col_max] 这段, 避免整页 128 列重发 */
static uint8_t OLED_col_min[8];
static uint8_t OLED_col_max[8];

/* 标记某页某列为脏, 并更新该页脏列区间 */
static void OLED_MarkDirty(uint8_t page, uint8_t col) {
    if (page >= 8 || col >= 128) return;
    OLED_dirty |= (1 << page);
    if (col < OLED_col_min[page]) OLED_col_min[page] = col;
    if (col > OLED_col_max[page]) OLED_col_max[page] = col;
}

static const uint8_t OLED_CMD_LIST[] = {
    0xAE, 0xD5, 0x80, 0xA8, 0x3F, 0xD3, 0x00, 0x40,
    0x8D, 0x14, 0x20, 0x02, 0xA1, 0xC8, 0xDA, 0x12,
    0x81, 0xCF, 0xD9, 0xF1, 0xDB, 0x40, 0xA4, 0xA6,
    0xAF
};

static const uint8_t Font8x16[][16] = {
    {0x00,0x00,0x00,0x00,0x00,0x00,0x00,0x00,0x00,0x00,0x00,0x00,0x00,0x00,0x00,0x00},
    {0x00,0x00,0x00,0xF8,0x00,0x00,0x00,0x00,0x00,0x00,0x00,0x33,0x30,0x00,0x00,0x00},
    {0x00,0x10,0x0C,0x06,0x10,0x0C,0x06,0x00,0x00,0x00,0x00,0x00,0x00,0x00,0x00,0x00},
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    {0x00,0x06,0x01,0x01,0x02,0x02,0x04,0x04,0x00,0x00,0x00,0x00,0x00,0x00,0x00,0x00},
};

typedef struct {
    GPIO_TypeDef *scl_port;
    uint16_t scl_pin;
    GPIO_TypeDef *sda_port;
    uint16_t sda_pin;
} OLED_Bus;

static const OLED_Bus OLED_BUSES[] = {
    {OLED_SCL_PORT, OLED_SCL_PIN, OLED_SDA_PORT, OLED_SDA_PIN},
};

static const uint8_t OLED_ADDR_LIST[] = {0x78};  // 只使用一个地址测试

/* 直接写 BSRR 寄存器: 低16位置位, 高16位复位, 比 HAL_GPIO_WritePin 快很多 */
static inline void SCL_High(const OLED_Bus *bus) { bus->scl_port->BSRR = bus->scl_pin; }
static inline void SCL_Low(const OLED_Bus *bus)  { bus->scl_port->BSRR = (uint32_t)bus->scl_pin << 16; }
static inline void SDA_High(const OLED_Bus *bus) { bus->sda_port->BSRR = bus->sda_pin; }
static inline void SDA_Low(const OLED_Bus *bus)  { bus->sda_port->BSRR = (uint32_t)bus->sda_pin << 16; }

/* 64MHz 下 60 次循环约 3.6us, SCL 半周期 ~140kHz, 远低于 SSD1306 上限 400kHz */
static void IIC_Delay(void) {
    for (volatile uint8_t i = 0; i < 60; i++) {
        __NOP();
    }
}

static void IIC_Start(const OLED_Bus *bus) {
    SDA_High(bus);
    SCL_High(bus);
    IIC_Delay();
    SDA_Low(bus);
    IIC_Delay();
    SCL_Low(bus);
    IIC_Delay();
}

static void IIC_Stop(const OLED_Bus *bus) {
    SDA_Low(bus);
    SCL_High(bus);
    IIC_Delay();
    SDA_High(bus);
    IIC_Delay();
}

/* 第 9 个 SCL 时钟供从机应答; SDA 全程保持推挽输出, 不再切换输入模式
 * (省去每字节两次 HAL_GPIO_Init 调用, 大幅提升刷新吞吐) */
static void IIC_WaitAck(const OLED_Bus *bus) {
    SDA_High(bus);
    IIC_Delay();
    SCL_High(bus);
    IIC_Delay();
    SCL_Low(bus);
}

static void IIC_WriteByte(const OLED_Bus *bus, uint8_t data) {
    for (uint8_t i = 0; i < 8; i++) {
        if (data & 0x80) SDA_High(bus);
        else SDA_Low(bus);
        data <<= 1;
        SCL_High(bus);
        IIC_Delay();
        SCL_Low(bus);
        IIC_Delay();
    }
    IIC_WaitAck(bus);
}

static void OLED_WriteCmdTo(const OLED_Bus *bus, uint8_t addr, uint8_t cmd) {
    IIC_Start(bus);
    IIC_WriteByte(bus, addr);
    IIC_WriteByte(bus, 0x00);
    IIC_WriteByte(bus, cmd);
    IIC_Stop(bus);
}

static void OLED_WriteCmd(uint8_t cmd) {
    for (uint8_t b = 0; b < sizeof(OLED_BUSES) / sizeof(OLED_BUSES[0]); b++) {
        for (uint8_t a = 0; a < sizeof(OLED_ADDR_LIST) / sizeof(OLED_ADDR_LIST[0]); a++) {
            OLED_WriteCmdTo(&OLED_BUSES[b], OLED_ADDR_LIST[a], cmd);
        }
    }
}

static void OLED_GPIO_Init(void) {
    GPIO_InitTypeDef GPIO_InitStruct = {0};
    __HAL_RCC_GPIOA_CLK_ENABLE();
    __HAL_RCC_GPIOB_CLK_ENABLE();

    GPIO_InitStruct.Mode = GPIO_MODE_OUTPUT_PP;
    GPIO_InitStruct.Pull = GPIO_NOPULL;
    GPIO_InitStruct.Speed = GPIO_SPEED_FREQ_HIGH;

    for (uint8_t b = 0; b < sizeof(OLED_BUSES) / sizeof(OLED_BUSES[0]); b++) {
        GPIO_InitStruct.Pin = OLED_BUSES[b].scl_pin;
        HAL_GPIO_Init(OLED_BUSES[b].scl_port, &GPIO_InitStruct);

        GPIO_InitStruct.Pin = OLED_BUSES[b].sda_pin;
        HAL_GPIO_Init(OLED_BUSES[b].sda_port, &GPIO_InitStruct);

        SCL_High(&OLED_BUSES[b]);
        SDA_High(&OLED_BUSES[b]);
    }
}

void OLED_Init(void) {
    OLED_GPIO_Init();
    HAL_Delay(100);
    for (uint8_t i = 0; i < sizeof(OLED_CMD_LIST); i++)
        OLED_WriteCmd(OLED_CMD_LIST[i]);
    OLED_Clear();
}

void OLED_Clear(void) {
    memset(OLED_GRAM, 0, sizeof(OLED_GRAM));
    OLED_dirty = 0xFF;
    for (uint8_t p = 0; p < 8; p++) { OLED_col_min[p] = 0; OLED_col_max[p] = 127; }
}

void OLED_Fill(uint8_t data) {
    memset(OLED_GRAM, data, sizeof(OLED_GRAM));
    OLED_dirty = 0xFF;
    for (uint8_t p = 0; p < 8; p++) { OLED_col_min[p] = 0; OLED_col_max[p] = 127; }
}

void OLED_SetCursor(uint8_t x, uint8_t y) {
    OLED_WriteCmd(0xB0 + y);
    OLED_WriteCmd((x >> 4) | 0x10);
    OLED_WriteCmd(x & 0x0F);
}

/* 只刷脏页的脏列区间 [col_min, col_max], 而非整页 128 列 */
void OLED_Update(void) {
    for (uint8_t page = 0; page < 8; page++) {
        if (!(OLED_dirty & (1 << page))) continue;
        uint8_t cmin = OLED_col_min[page];
        uint8_t cmax = OLED_col_max[page];
        if (cmin > cmax) { OLED_dirty &= ~(1 << page); continue; }
        OLED_WriteCmd(0xB0 + page);
        OLED_WriteCmd(cmin & 0x0F);          /* 列地址低 4 位 */
        OLED_WriteCmd(0x10 | (cmin >> 4));   /* 列地址高 4 位 */
        for (uint8_t b = 0; b < sizeof(OLED_BUSES) / sizeof(OLED_BUSES[0]); b++) {
            for (uint8_t a = 0; a < sizeof(OLED_ADDR_LIST) / sizeof(OLED_ADDR_LIST[0]); a++) {
                IIC_Start(&OLED_BUSES[b]);
                IIC_WriteByte(&OLED_BUSES[b], OLED_ADDR_LIST[a]);
                IIC_WriteByte(&OLED_BUSES[b], 0x40);
                for (uint8_t col = cmin; col <= cmax; col++)
                    IIC_WriteByte(&OLED_BUSES[b], OLED_GRAM[col][page]);
                IIC_Stop(&OLED_BUSES[b]);
            }
        }
        OLED_col_min[page] = 255;            /* 复位该页脏列区间 */
        OLED_col_max[page] = 0;
        OLED_dirty &= ~(1 << page);
    }
}

void OLED_ShowString(uint8_t x, uint8_t y, const char *str) {
    while (*str) {
        if (x > 120) { x = 0; y += 2; }
        if (y > 6) break;
        uint8_t c = *str - ' ';
        if (c < sizeof(Font8x16) / sizeof(Font8x16[0])) {
            for (uint8_t i = 0; i < 8; i++) {
                OLED_GRAM[x + i][y]     = Font8x16[c][i];
                OLED_GRAM[x + i][y + 1] = Font8x16[c][i + 8];
                OLED_MarkDirty(y, x + i);
                OLED_MarkDirty(y + 1, x + i);
            }
        }
        x += 8;
        str++;
    }
}

void OLED_ShowNum(uint8_t x, uint8_t y, uint32_t num, uint8_t len) {
    char buf[12];
    uint8_t i = len;
    buf[i] = '\0';
    while (i--) {
        buf[i] = '0' + (num % 10);
        num /= 10;
    }
    OLED_ShowString(x, y, buf);
}

void OLED_DisplayOn(void) {
    OLED_WriteCmd(0x8D);
    OLED_WriteCmd(0x14);
    OLED_WriteCmd(0xAF);
}

void OLED_DisplayOff(void) {
    OLED_WriteCmd(0xAE);
    OLED_WriteCmd(0x8D);
    OLED_WriteCmd(0x10);
}

/* GRAM 布局为 OLED_GRAM[128][8]：列在前、page 在后 */
void OLED_ClearArea(uint8_t x, uint8_t y, uint8_t width, uint8_t height) {
    for (uint8_t page = y; page < y + height && page < 8; page++) {
        for (uint8_t col = x; col < x + width && col < 128; col++) {
            OLED_GRAM[col][page] = 0x00;
            OLED_MarkDirty(page, col);
        }
    }
}

